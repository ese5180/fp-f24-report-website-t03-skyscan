## CMakeLists.txt
```
# Copyright (c) 2021 Nordic Semiconductor
# SPDX-License-Identifier: LicenseRef-Nordic-5-Clause

cmake_minimum_required(VERSION 3.20.0)

# Find Zephyr
find_package(Zephyr REQUIRED HINTS $ENV{ZEPHYR_BASE})
project(gateway)

# Add application source directory
target_sources(app PRIVATE src/main.c)

# Include directories
zephyr_include_directories(src)
zephyr_include_directories(config)

# Define Memfault custom metrics
set(MEMFAULT_METRICS_USER_HEARTBEAT_DEFS_FILE "memfault_metrics_heartbeat_zephyr_port_config.def")
target_include_directories(app PRIVATE ${CMAKE_CURRENT_SOURCE_DIR}/config)

# Link Memfault SDK library
target_link_libraries(app PRIVATE memfault-firmware-sdk)
```

## prj.conf
```kconfig
# Copyright (c) 2021 Nordic Semiconductor ASA
# SPDX-License-Identifier: LicenseRef-Nordic-5-Clause

# --- Memfault Configuration ---
CONFIG_MEMFAULT=y
CONFIG_MEMFAULT_NCS_PROJECT_KEY="nKk3wFLhEzL7s8v9EKjl0dCD137uBlyE"
CONFIG_MEMFAULT_METRICS=y
CONFIG_MEMFAULT_SHELL=y
CONFIG_MEMFAULT_HTTP_ENABLE=y
CONFIG_MEMFAULT_HTTP_PERIODIC_UPLOAD=y
CONFIG_MEMFAULT_HTTP_PERIODIC_UPLOAD_INTERVAL_SECS=60
CONFIG_MEMFAULT_LOGGING_ENABLE=y
CONFIG_MEMFAULT_LOG_LEVEL_DBG=y
CONFIG_MEMFAULT_NCS_INTERNAL_FLASH_BACKED_COREDUMP=y
CONFIG_MEMFAULT_COREDUMP_COLLECT_BSS_REGIONS=y
CONFIG_MEMFAULT_NCS_FW_TYPE="app"
CONFIG_MEMFAULT_NCS_DEVICE_ID_STATIC=y
CONFIG_MEMFAULT_NCS_DEVICE_ID="skyscandevice_2"

# --- Wi-Fi Configuration ---
CONFIG_WIFI=y
CONFIG_WIFI_NRF700X=y
CONFIG_WIFI_CREDENTIALS=y
CONFIG_WIFI_CREDENTIALS_STATIC=y
CONFIG_WIFI_CREDENTIALS_STATIC_SSID="wifi07078"
CONFIG_WIFI_CREDENTIALS_STATIC_PASSWORD="9178533161"
CONFIG_WPA_SUPP=y
CONFIG_NET_L2_WIFI_SHELL=y
CONFIG_NET_L2_WIFI_MGMT=y
CONFIG_WIFI_MGMT_EXT=y

# --- Logging Configuration ---
CONFIG_LOG=y
CONFIG_LOG_MODE_IMMEDIATE=y
CONFIG_LOG_DEFAULT_LEVEL=3

# --- Networking Configuration ---
CONFIG_NETWORKING=y
CONFIG_NET_NATIVE=y
CONFIG_NET_IPV4=y
CONFIG_NET_CONNECTION_MANAGER=y
CONFIG_NET_MGMT=y
CONFIG_NET_MGMT_EVENT=y
CONFIG_NET_MGMT_EVENT_INFO=y
CONFIG_NET_STATISTICS=y
CONFIG_NET_STATISTICS_WIFI=y
CONFIG_NET_STATISTICS_USER_API=y

# --- Bluetooth Configuration ---
CONFIG_BT_MDS=y
CONFIG_MEMFAULT_NCS_BT_METRICS=y
CONFIG_MEMFAULT_NCS_STACK_METRICS=y

# --- Flash and Storage ---
CONFIG_FLASH=y
CONFIG_FLASH_MAP=y
CONFIG_STREAM_FLASH=y

# --- Heap and Stack Configuration ---
CONFIG_HEAP_MEM_POOL_SIZE=8192
CONFIG_MAIN_STACK_SIZE=8192
CONFIG_SYSTEM_WORKQUEUE_STACK_SIZE=2048
CONFIG_NET_CONNECTION_MANAGER_MONITOR_STACK_SIZE=1024
CONFIG_NET_MGMT_EVENT_STACK_SIZE=1024

# --- System Settings ---
CONFIG_NEWLIB_LIBC=y
CONFIG_NEWLIB_LIBC_NANO=n
CONFIG_UART_INTERRUPT_DRIVEN=y
CONFIG_UART_CONSOLE=y

# --- TLS Support ---
CONFIG_MBEDTLS_SSL_SERVER_NAME_INDICATION=y
CONFIG_TLS_CREDENTIALS=y
CONFIG_TLS_MAX_CREDENTIALS_NUMBER=3
CONFIG_NET_SOCKETS_TLS_MAX_CREDENTIALS=3
```

## src/main.c
```c
#include <zephyr/kernel.h>
#include <zephyr/net/conn_mgr_connectivity.h>
#include <zephyr/net/conn_mgr_monitor.h>
#include <memfault/metrics/metrics.h>
#include <memfault/ports/zephyr/http.h>
#include <memfault/core/data_packetizer.h>
#include <dk_buttons_and_leds.h>

#include <zephyr/logging/log.h>

LOG_MODULE_REGISTER(memfault_sample, CONFIG_MEMFAULT_SAMPLE_LOG_LEVEL);

#define L4_EVENT_MASK          (NET_EVENT_L4_CONNECTED | NET_EVENT_L4_DISCONNECTED)
#define CONN_LAYER_EVENT_MASK  (NET_EVENT_CONN_IF_FATAL_ERROR)

static K_SEM_DEFINE(nw_connected_sem, 0, 1);
static struct net_mgmt_event_callback l4_cb;
static struct net_mgmt_event_callback conn_cb;

/* Retrieve device temperature mock function */
static uint32_t get_device_temperature(void) {
    return 25;  // Replace with sensor logic
}

static void update_device_metrics(void) {
    uint32_t temperature = get_device_temperature();
    MEMFAULT_METRIC_SET_UNSIGNED(device_temperature, temperature);

    LOG_INF("Device temperature updated: %u", temperature);
}

static void on_connect(void) {
    LOG_INF("Connected to network. Sending data to Memfault...");
    memfault_zephyr_port_post_data();
}

static void l4_event_handler(struct net_mgmt_event_callback *cb, uint32_t event, struct net_if *iface) {
    switch (event) {
    case NET_EVENT_L4_CONNECTED:
        LOG_INF("Network connectivity established");
        k_sem_give(&nw_connected_sem);
        break;
    case NET_EVENT_L4_DISCONNECTED:
        LOG_INF("Network connectivity lost");
        break;
    }
}

int main(void) {
    int err;
    LOG_INF("Memfault sample has started");

    net_mgmt_init_event_callback(&l4_cb, l4_event_handler, L4_EVENT_MASK);
    net_mgmt_add_event_callback(&l4_cb);

    LOG_INF("Connecting to network...");
    err = conn_mgr_all_if_up(true);
    if (err) {
        LOG_ERR("Failed to bring up interface");
        return err;
    }

    err = conn_mgr_all_if_connect(true);
    if (err) {
        LOG_ERR("Failed to connect to network");
        return err;
    }

    k_sem_take(&nw_connected_sem, K_FOREVER);

    while (1) {
        on_connect();
        update_device_metrics();
        k_sleep(K_SECONDS(60));
    }

    return 0;
}
```

## src/lora.c
```c
#include <SPI.h>
#include <LoRa.h>

#define SS_PIN 18
#define RST_PIN 23
#define DIO0_PIN 26

void setup()
{
    Serial.begin(115200);
    while (!Serial)
        ;

    LoRa.setPins(SS_PIN, RST_PIN, DIO0_PIN);
    if (!LoRa.begin(915E6))
    {
        Serial.println("LoRa initialization failed!");
        while (1)
            ;
    }
}

void loop()
{
    // Check for incoming UART data
    if (Serial.available())
    {
        String packet = Serial.readStringUntil('\n');
        forwardLoRaPacket(packet);
    }

    // Check for incoming LoRa packets
    int packetSize = LoRa.parsePacket();
    if (packetSize)
    {
        String receivedPacket = receiveLoRaPacket();
        forwardUartPacket(receivedPacket);
    }
}

void forwardLoRaPacket(String packet)
{
    LoRa.beginPacket();
    LoRa.print(packet);
    LoRa.endPacket();
    Serial.println("Forwarded LoRa packet: " + packet);
}

String receiveLoRaPacket()
{
    String packet = "";
    while (LoRa.available())
    {
        packet += (char)LoRa.read();
    }
    return packet;
}

void forwardUartPacket(String packet)
{
    Serial.println(packet);
}
```

## src/main2.c
```c
/*
 * Copyright (c) 2021 Nordic Semiconductor ASA
 *
 * SPDX-License-Identifier: LicenseRef-Nordic-5-Clause
 */

#include <zephyr/kernel.h>
#include <stdio.h>
#include <zephyr/net/conn_mgr_connectivity.h>
#include <zephyr/net/conn_mgr_monitor.h>
#include <memfault/metrics/metrics.h>
#include <memfault/ports/zephyr/http.h>
#include <memfault/core/data_packetizer.h>
#include <memfault/core/trace_event.h>
#include <dk_buttons_and_leds.h>

#include <zephyr/logging/log.h>
#include <zephyr/logging/log_ctrl.h>

LOG_MODULE_REGISTER(memfault_sample, CONFIG_MEMFAULT_SAMPLE_LOG_LEVEL);

/* Macros used to subscribe to specific Zephyr NET management events. */
#define L4_EVENT_MASK (NET_EVENT_L4_CONNECTED | NET_EVENT_L4_DISCONNECTED)
#define CONN_LAYER_EVENT_MASK (NET_EVENT_CONN_IF_FATAL_ERROR)

static K_SEM_DEFINE(nw_connected_sem, 0, 1);

/* Zephyr NET management event callback structures. */
static struct net_mgmt_event_callback l4_cb;
static struct net_mgmt_event_callback conn_cb;

/* Recursive Fibonacci calculation used to trigger stack overflow. */
static int fib(int n)
{
	if (n <= 1)
	{
		return n;
	}

	return fib(n - 1) + fib(n - 2);
}

/* Handle button presses and trigger faults that can be captured and sent to
 * the Memfault cloud for inspection after rebooting:
 * Only button 1 is available on Thingy:91, the rest are available on nRF9160 DK.
 *	Button 1: Trigger stack overflow.
 *	Button 2: Trigger NULL-pointer dereference.
 *	Switch 1: Increment switch_1_toggle_count metric by one.
 *	Switch 2: Trace switch_2_toggled event, along with switch state.
 */
static void button_handler(uint32_t button_states, uint32_t has_changed)
{
	uint32_t buttons_pressed = has_changed & button_states;

	if (buttons_pressed & DK_BTN1_MSK)
	{
		LOG_WRN("Stack overflow will now be triggered");
		fib(10000);
	}
	else if (buttons_pressed & DK_BTN2_MSK)
	{
		volatile uint32_t i;

		LOG_WRN("Division by zero will now be triggered");
#pragma GCC diagnostic push
#pragma GCC diagnostic ignored "-Wdiv-by-zero"
		i = 1 / 0;
#pragma GCC diagnostic pop
		ARG_UNUSED(i);
	}
	else if (has_changed & DK_BTN3_MSK)
	{
		/* DK_BTN3_MSK is Switch 1 on nRF9160 DK. */
		int err = MEMFAULT_METRIC_ADD(switch_1_toggle_count, 1);
		if (err)
		{
			LOG_ERR("Failed to increment switch_1_toggle_count");
		}
		else
		{
			LOG_INF("switch_1_toggle_count incremented");
		}
	}
	else if (has_changed & DK_BTN4_MSK)
	{
		/* DK_BTN4_MSK is Switch 2 on nRF9160 DK. */
		MEMFAULT_TRACE_EVENT_WITH_LOG(switch_2_toggled, "Switch state: %d",
									  buttons_pressed & DK_BTN4_MSK ? 1 : 0);
		LOG_INF("switch_2_toggled event has been traced, button state: %d",
				buttons_pressed & DK_BTN4_MSK ? 1 : 0);
	}
}

static void on_connect(void)
{
#if IS_ENABLED(MEMFAULT_NCS_LTE_METRICS)
	uint32_t time_to_lte_connection;

	/* Retrieve the LTE time to connect metric. */
	memfault_metrics_heartbeat_timer_read(MEMFAULT_METRICS_KEY(ncs_lte_time_to_connect_ms),
										  &time_to_lte_connection);

	LOG_INF("Time to connect: %d ms", time_to_lte_connection);
#endif /* IS_ENABLED(MEMFAULT_NCS_LTE_METRICS) */

	LOG_INF("Sending already captured data to Memfault");

	/* Trigger collection of heartbeat data. */
	memfault_metrics_heartbeat_debug_trigger();

	/* Check if there is any data available to be sent. */
	if (!memfault_packetizer_data_available())
	{
		LOG_DBG("There was no data to be sent");
		return;
	}

	LOG_DBG("Sending stored data...");

	/* Send the data that has been captured to the memfault cloud.
	 * This will also happen periodically, with an interval that can be configured using
	 * CONFIG_MEMFAULT_HTTP_PERIODIC_UPLOAD_INTERVAL_SECS.
	 */
	memfault_zephyr_port_post_data();
}

static void l4_event_handler(struct net_mgmt_event_callback *cb, uint32_t event,
							 struct net_if *iface)
{
	switch (event)
	{
	case NET_EVENT_L4_CONNECTED:
		LOG_INF("Network connectivity established");
		k_sem_give(&nw_connected_sem);
		break;
	case NET_EVENT_L4_DISCONNECTED:
		LOG_INF("Network connectivity lost");
		break;
	default:
		LOG_DBG("Unknown event: 0x%08X", event);
		return;
	}
}

static void connectivity_event_handler(struct net_mgmt_event_callback *cb, uint32_t event,
									   struct net_if *iface)
{
	if (event == NET_EVENT_CONN_IF_FATAL_ERROR)
	{
		__ASSERT(false, "Failed to connect to a network");
		return;
	}
}

static uint32_t get_device_temperature(void)
{
	// Replace with actual sensor code to fetch the device temperature
	return 25; // Example: Return a mock value
}

static void update_device_metrics(void)
{
	uint32_t temperature = get_device_temperature();
	MEMFAULT_METRIC_SET_UNSIGNED(device_temperature, temperature);

	// Optionally trigger a heartbeat to send metrics immediately
	memfault_metrics_heartbeat_debug_trigger();

	LOG_INF("Device temperature updated: %u", temperature);
}

int main(void)
{
	int err;
	uint32_t temperature = 25;

	LOG_INF("Memfault sample has started");

	err = dk_buttons_init(button_handler);
	if (err)
	{
		LOG_ERR("dk_buttons_init, error: %d", err);
	}
	/* Setup handler for Zephyr NET Connection Manager events. */
	net_mgmt_init_event_callback(&l4_cb, l4_event_handler, L4_EVENT_MASK);
	net_mgmt_add_event_callback(&l4_cb);

	/* Setup handler for Zephyr NET Connection Manager Connectivity layer. */
	net_mgmt_init_event_callback(&conn_cb, connectivity_event_handler, CONN_LAYER_EVENT_MASK);
	net_mgmt_add_event_callback(&conn_cb);

	/* Connecting to the configured connectivity layer.
	 * Wi-Fi or LTE depending on the board that the sample was built for.
	 */
	LOG_INF("Bringing network interface up and connecting to the network");

	err = conn_mgr_all_if_up(true);
	if (err)
	{
		__ASSERT(false, "conn_mgr_all_if_up, error: %d", err);
		return err;
	}

	err = conn_mgr_all_if_connect(true);
	if (err)
	{
		__ASSERT(false, "conn_mgr_all_if_connect, error: %d", err);
		return err;
	}

	/* Performing in an infinite loop to be resilient against
	 * re-connect bursts directly after boot, e.g. when connected
	 * to a roaming network or via weak signal. Note that
	 * Memfault data will be uploaded periodically every
	 * CONFIG_MEMFAULT_HTTP_PERIODIC_UPLOAD_INTERVAL_SECS.
	 * We post data here so as soon as a connection is available
	 * the latest data will be pushed to Memfault.
	 */

	k_sem_take(&nw_connected_sem, K_FOREVER);

	while (1)
	{

		LOG_INF("Connected to network");
		on_connect();

		MEMFAULT_METRIC_SET_UNSIGNED(device_temperature, temperature);
		LOG_INF("Updated device_temperature metric: %d", temperature);
		// temperature +=1;

		update_device_metrics();
		k_sleep(K_SECONDS(60));
	}
}
```
